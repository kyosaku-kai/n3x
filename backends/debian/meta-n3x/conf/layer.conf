## backends/debian/meta-n3x/conf/layer.conf
```bitbake
# n3x custom layer for Isar builds
# Adds machine configs, images, and recipes

BBPATH .= ":${LAYERDIR}"

BBFILES += " \
    ${LAYERDIR}/recipes-*/*/*.bb \
    ${LAYERDIR}/recipes-*/*/*.bbappend \
"

BBFILE_COLLECTIONS += "meta-n3x"
BBFILE_PATTERN_meta-n3x := "^${LAYERDIR}/"

# Isar layer series compatibility
LAYERSERIES_COMPAT_meta-n3x = "v0.6"

# Layer dependencies
LAYERDEPENDS_meta-n3x = "core isar"
```

## backends/isar/meta-isar-k3s/conf/layer.conf
```bitbake
# isar-k3s custom layer for Isar builds
# Adds k3s-focused machine configs, images, and recipes

BBPATH .= ":${LAYERDIR}"

BBFILES += " \
    ${LAYERDIR}/recipes-*/*/*.bb \
    ${LAYERDIR}/recipes-*/*/*.bbappend \
"

BBFILE_COLLECTIONS += "meta-isar-k3s"
BBFILE_PATTERN_meta-isar-k3s := "^${LAYERDIR}/"

# Isar layer series compatibility
LAYERSERIES_COMPAT_meta-isar-k3s = "v0.6"

# Layer dependencies
LAYERDEPENDS_meta-isar-k3s = "core isar"
```

## backends/isar/meta-isar-k3s/conf/machine/amd-v3c18i.conf
```bitbake
#
# AMD V3C18i (Fox board) machine configuration for Isar
#
# Hardware: AMD Ryzen Embedded V3000 series (V3C18I variant)
# - No integrated GPU - serial console required
# - Serial: UART0 (J38) -> ttyS4, 115200n8
# - UEFI boot with GRUB
# - Standard x86_64 architecture
#
# References:
# - AMD/57102_1.01_Platform-Users-Guide-FOX-V3000.pdf
# - AMD/56149_0.50_Remote-Headless-Mode-V3000-FOX.pdf
#

DISTRO_ARCH ?= "amd64"

KERNEL_NAME ?= "amd64"

# UEFI boot with GPT partitioning
IMAGE_FSTYPES ?= "wic"
WKS_FILE ?= "efi-plus-pcbios"

# Bootloader installation (GRUB EFI + legacy BIOS fallback)
IMAGER_INSTALL:wic += " \
    ${GRUB_BOOTLOADER_INSTALL} \
    ${SYSLINUX_BOOTLOADER_INSTALL}"

# Serial console configuration
# V3C18I: UART0 (J38 connector) maps to ttyS4
MACHINE_SERIAL ?= "ttyS4"
BAUDRATE_TTY ?= "115200"

# Required firmware packages for AMD V3000
# - amd64-microcode: CPU microcode updates (security critical)
# Note: linux-firmware not needed - V3C18i has no iGPU (headless board)
# If dGPU is added later, install firmware-linux-nonfree (requires non-free repo)
IMAGE_PREINSTALL:append = " amd64-microcode"
```

## backends/isar/meta-isar-k3s/conf/machine/jetson-orin-nano.conf
```bitbake
#
# NVIDIA Jetson Orin Nano machine configuration for Isar
#
# Hardware: NVIDIA Jetson Orin Nano 8GB Developer Kit
# - SoC: Tegra234 (Orin family)
# - Serial: ttyTCU0 (Tegra Combined UART), 115200n8
# - Boot: NVIDIA L4T flash tools (not GRUB)
# - Storage: NVMe SSD or SD card
#
# Notes:
# - This config produces a rootfs tarball for integration with L4T BSP
# - WIC images are NOT used - L4T flash tools handle partitioning
# - Boot slot management via nvbootctrl (A/B partitions)
#
# Flash workflow:
# 1. Build with ISAR -> rootfs tarball
# 2. Extract to Linux_for_Tegra/rootfs/
# 3. Run apply_binaries.sh
# 4. Flash with l4t_initrd_flash.sh
#

DISTRO_ARCH ?= "arm64"

KERNEL_NAME ?= "arm64"

# Produce rootfs tarball for L4T integration (not WIC)
# L4T flash tools handle partition layout and bootloader
IMAGE_FSTYPES ?= "tar.gz"

# Serial console configuration
# Jetson Orin Nano uses Tegra Combined UART (ttyTCU0)
MACHINE_SERIAL ?= "ttyTCU0"
BAUDRATE_TTY ?= "115200"

# NVIDIA L4T packages are added via kas/machine/jetson-orin-nano.yml
# using IMAGE_INSTALL:append with prebuilt .deb recipes
# See: meta-isar-k3s/recipes-bsp/nvidia-l4t/
```

## backends/isar/meta-isar-k3s/wic/sdimage-efi-ab.wks
```
# =============================================================================
# A/B Rootfs EFI Disk Image for SWUpdate OTA
# =============================================================================
#
# Creates a GPT partitioned EFI disk with dual rootfs partitions for A/B OTA
# updates using SWUpdate.
#
# Partition Layout:
# ┌──────────────────────────────────────────────────────────────────────────┐
# │ GPT                                                                       │
# ├──────────┬───────────────┬───────────────┬──────────────────────────────┤
# │ EFI      │ APP           │ APP_b         │ data                         │
# │ (ESP)    │ rootfs-a      │ rootfs-b      │ persistent                   │
# │ 256MB    │ 2GB           │ 2GB           │ remaining                    │
# │ vfat     │ ext4          │ ext4          │ ext4                         │
# │ /boot    │ / (active)    │ (inactive)    │ /data                        │
# └──────────┴───────────────┴───────────────┴──────────────────────────────┘
#
# Usage with kas:
#   kas-build kas/base.yml:kas/machine/qemu-amd64.yml:kas/feature/swupdate.yml
#
# SWUpdate Flow:
#   1. System boots from APP (rootfs-a)
#   2. SWUpdate applies update to APP_b (rootfs-b)
#   3. SWUpdate sets grubenv rootfs_slot=b
#   4. System reboots into APP_b
#   5. Next update goes to APP (now inactive)
#
# GRUB Configuration:
#   The EFI partition contains GRUB bootloader and grubenv file.
#   GRUB reads rootfs_slot from grubenv to select boot partition.
#   grubenv location: /boot/efi/EFI/BOOT/grubenv
#
# =============================================================================

# EFI System Partition (ESP)
# Contains GRUB-EFI bootloader and grubenv for A/B switching
# Use --use-uuid to generate PARTUUID-based fstab entries for virtio compatibility
# Without this, WIC generates /dev/sda1 which doesn't exist when using QEMU virtio disks (/dev/vda1)
part /boot --source bootimg-efi-isar --sourceparams "loader=grub-efi" --ondisk sda --label efi --part-type EF00 --align 1024 --use-uuid

# Rootfs A (APP) - Primary partition, initially active
# This is where the image rootfs is installed during initial flash
part / --source rootfs --ondisk sda --fstype ext4 --mkfs-extraopts "-T default" --label APP --align 1024 --use-uuid --exclude-path boot/ --fixed-size 2G

# Rootfs B (APP_b) - Secondary partition, initially empty
# SWUpdate writes updates here; formatted but no content initially
# Note: --no-table not available; this creates empty ext4 partition
part --ondisk sda --fstype ext4 --mkfs-extraopts "-T default" --label APP_b --align 1024 --fixed-size 2G

# Persistent data partition
# Survives OTA updates; used for configuration, logs, k3s data
# Note: --fixed-size required for partitions without --source; can expand later via growpart
part /data --ondisk sda --fstype ext4 --mkfs-extraopts "-T default" --label data --align 1024 --use-uuid --fixed-size 1G

# Bootloader configuration
# GPT required for EFI; timeout allows boot interruption for debugging
# configfile points to A/B aware GRUB config that reads grubenv for slot selection
bootloader --ptable gpt --timeout 3 --configfile grub-ab.cfg --append "rootwait console=ttyS0,115200 console=tty0"
```

## backends/isar/meta-isar-k3s/wic/sdimage-efi-k3s.wks
```
# K3s optimized EFI disk image
#
# Based on sdimage-efi.wks but with extra space for k3s runtime.
# k3s extracts ~200MB of embedded binaries on first run to /var/lib/rancher/k3s/data/
# We add 512MB extra space to accommodate this plus container images.

# Use --use-uuid to generate PARTUUID-based fstab entries for virtio compatibility
# Without this, WIC generates /dev/sda1 which doesn't exist when using QEMU virtio disks (/dev/vda1)
part /boot --source bootimg-efi-isar --sourceparams "loader=grub-efi" --ondisk sda --label efi --part-type EF00 --align 1024 --use-uuid

# Add 512MB extra space for k3s runtime binaries and container images
part / --source rootfs --ondisk sda --fstype ext4 --mkfs-extraopts "-T default" --label platform --align 1024 --use-uuid --exclude-path boot/ --extra-space 512M

include expand-padding.wks.inc

# net.ifnames=0 biosdevname=0 - Use legacy eth* interface names for NixOS test driver compatibility
# The systemd-networkd config files reference eth1, not enp0s* predictable names
# quiet loglevel=1 - Suppress kernel boot messages that can corrupt the backdoor shell protocol
# console=ttyS0 ONLY (no tty0) - All kernel output to serial, keeping hvc0 clean for backdoor
bootloader --ptable gpt --timeout 3 --append "rootwait console=ttyS0,115200 net.ifnames=0 biosdevname=0 quiet loglevel=1"
```

## build/conf/bblayers.conf
```bitbake
BBLAYERS ?= " \
    ${TOPDIR}/../work/isar/meta \
    ${TOPDIR}/../work/isar/meta-isar \
    ${TOPDIR}/../work/meta-isar-k3s"
BBPATH ?= "${TOPDIR}"
BBFILES ??= ""
```

## build/conf/local.conf
```bitbake
# isar-k3s-base
# isar-k3s common configuration
DISTRO_APT_PREMIRRORS = ""

# isar-k3s-compression
# Use pigz for parallel gzip compression (significantly faster on multi-core)
# This replaces single-threaded gzip in CONVERSION_CMD:gz
# Requires pigz to be installed in the build environment
CONVERSION_DEPS:gz = "pigz"
CONVERSION_CMD:gz = "${SUDO_CHROOT} sh -c 'pigz -f -9 -n -c -k ${IMAGE_FILE_CHROOT} > ${IMAGE_FILE_CHROOT}.gz'"

# Use parallel xz compression (xz supports -T for threads)
XZ_DEFAULTS ?= "-T 0"

# Use parallel zstd compression (zstd supports -T for threads)
ZSTD_DEFAULTS ?= "-T0 -19"

# isar-k3s-parallelism
# Parallelism settings to PREVENT SWAPPING
# Goal: Keep peak memory under 24GB (28GB system - 4GB headroom)
#
# BB_NUMBER_THREADS: concurrent BitBake tasks (recipe-level parallelism)
# Heavy tasks (kernel compile, linking) can use 2-4GB each
# 24GB / ~3GB avg = 8 concurrent heavy tasks max
BB_NUMBER_THREADS = "8"

# PARALLEL_MAKE: -j flag for make (within-recipe parallelism)
# Keep at full CPU count - memory is limited by BB_NUMBER_THREADS
# PARALLEL_MAKE defaults to -j20 (auto-detected)

# BB_PRESSURE_MAX_MEMORY: Backup throttle if pressure rises despite limits
# Value is microseconds of stall per second (10000 = 1% threshold)
# Reacts early before OOM killer intervenes
BB_PRESSURE_MAX_MEMORY = "10000"

# network-simple
# Simple network profile - single flat network on eth1
# Uses systemd-networkd config files generated from Nix profiles
IMAGE_INSTALL:append = " systemd-networkd-config"
NETWORKD_PROFILE = "simple"
# NETWORKD_NODE_NAME set by kas/node/*.yml overlay

# node-identity
# Node identity for systemd-networkd-config
NETWORKD_NODE_NAME = "server-1"

# shared-cache
# Shared user-level cache directories for all Yocto/ISAR projects
# This enables cache reuse across multiple projects/builds
# BitBake auto-creates these directories if they don't exist
DL_DIR = "${HOME}/.cache/yocto/downloads"
SSTATE_DIR = "${HOME}/.cache/yocto/sstate"

# test-k3s-config
# Include NixOS test driver backdoor service
# This enables VM testing with nixos-test-driver
IMAGE_INSTALL:append = " nixos-test-backdoor"

MACHINE ??= "qemuamd64"
DISTRO ??= "debian-trixie"
BBMULTICONFIG ?= ""
```
